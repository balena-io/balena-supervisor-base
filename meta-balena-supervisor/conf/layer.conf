## meta-balena-supervisor/conf/layer.conf
```bitbake
BBPATH .= ":${LAYERDIR}"

BBFILES += "${LAYERDIR}/recipes-*/*/*.bb \
            ${LAYERDIR}/recipes-*/*/*.bbappend"

BBFILE_COLLECTIONS += "balena-supervisor"
BBFILE_PATTERN_balena-supervisor := "^${LAYERDIR}/"
BBFILE_PRIORITY_balena-supervisor = "1337"
```

## meta-balena-supervisor/conf/machine/generic-armv8.conf
```bitbake
#@TYPE: Machine
#@NAME: Generic armv8 machine
#@DESCRIPTION: Machine configuration for armv8 based boards

require conf/machine/include/arm/arch-armv8a.inc

DEFAULTTUNE = "aarch64"
```

## meta-balena-supervisor/conf/machine/generic-x86-64.conf
```bitbake
#@TYPE: Machine
#@NAME: common_pc
#@DESCRIPTION: Machine configuration for running a common x86-64

DEFAULTTUNE ?= "core2-64"
require conf/machine/include/tune-core2.inc
```

## meta-balena-supervisor/conf/machine/i386-nlp.conf
```bitbake
#@TYPE: Machine
#@NAME: common_pc
#@DESCRIPTION: Machine configuration for x86 with quark cpu boards.

require conf/machine/include/tune-i586-nlp.inc

PREFERRED_VERSION_nodejs = "6.13.1"
PREFERRED_VERSION_nodejs-native = "6.13.1"
```
